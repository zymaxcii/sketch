// dotMatrixDisplay.ino
// https://www.engineersgarage.com/dot-matrix-display-using-arduino/

#define shcp_colun 7          // coln
#define stcp_colun 8          // coln
#define ds_colun 9             // coln
#define shcp_row 10           //  row
#define stcp_row 11           //row
#define ds_row 13    
int scr_speed,p,j,i,lenth,temp;
int data_row,data_colon;
int move_data[30];
int colun_data[31]={1,0,0,0,0,0,0,0,0,0,0,0,0,0,0,0,0,0,0,0,0,0,0,0,0,0,0,0,0,0,0};
char inputString[100];
char font_5x7[95][6] = {
    {0x00,0x00,0x00,0x00,0x00}, //
    {0x00,0x00,0x7d,0x00,0x00}, // !
    {0x00,0x70,0x00,0x70,0x00}, // "
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    {0x08,0x10,0x08,0x10,0x00}, // ~
};
void setup()
{
 Serial.begin(9600); 
 pinMode(shcp_colun, OUTPUT);
 pinMode(stcp_colun, OUTPUT);
 pinMode(ds_colun, OUTPUT);
 pinMode(shcp_row, OUTPUT);
 pinMode(stcp_row, OUTPUT);
 pinMode(ds_row, OUTPUT);
 }
void loop()
{ 
 int i;
 while(1){
   char *Str="Dot Matrix by SADDAM KHAN   ";
   while(*Str!=''){
    printf(*Str);
    Str++;
   }
  }
}
void scroll(char a,char b,char c,char d,char e)            //input_string function //
{
  int count=6; 
  while(count>0){
    move_data[0]=a;a=b;b=c;c=d;d=e;e=0;
    for(scr_speed=0;scr_speed<50;scr_speed++){
      for(i=0;i<30;i++){
        temp=move_data[i];
        for(j=0;j<8;j++){
          data_row=(temp&(0x80));
          digitalWrite(ds_row,data_row);
          temp<<=1;
          digitalWrite(shcp_row,HIGH);
          for(int z=0;z<3;z++){}
          digitalWrite(shcp_row,LOW);
          }
        data_colon=colun_data[i];
        digitalWrite(ds_colun, data_colon);
        digitalWrite(shcp_colun,HIGH);//delay(1);
        digitalWrite(shcp_colun,LOW);
        digitalWrite(stcp_row,HIGH);//delay(1);
        digitalWrite(stcp_colun,HIGH);
        digitalWrite(stcp_row,LOW);
        digitalWrite(stcp_colun,LOW);
        if(Serial.available()){serial_string();}    
       }
    }
  for(i=29;i>0;i--){move_data[i]=move_data[i-1];}
  count--;
 }
}
void printf(char khan)
{ 
    p=khan-32;
    scroll(font_5x7[p][0],font_5x7[p][1],font_5x7[p][2],font_5x7[p][3],font_5x7[p][4]);
}
void serial_string()
{
  for(i=0;i<100;i++){
    inputString[i]=0;}
  lenth=0;
  for(lenth=0;lenth<3;lenth++){
    inputString[lenth]=' ';}
  lenth=3;
  while(1){
    while(Serial.available()){
      char inChar = (char)Serial.read(); 
      inputString[lenth]= inChar;
      lenth++; 
      if(inChar=='n'){
        while(1){
          for(int z=0;z<lenth-2;z++){
            printf(inputString[z]);}
  }}}}
}

